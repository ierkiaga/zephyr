## boards/arm/xilinx_zcu102/Kconfig.board
```kconfig
config BOARD_XILINX_ZCU102_BOARD
	bool "Xilinx ZynqMP ZCU102 Board"
	depends on SOC_XILINX_ZYNQMP
	select DISABLE_TCM_ECC
```

## boards/arm/xilinx_zcu102/Kconfig.defconfig
```kconfig
if BOARD_XILINX_ZCU102_BOARD

config BOARD
	default "xilinx_zcu102_board"

config BUILD_OUTPUT_STRIPPED
	def_bool y

config FLASH_SIZE
	int
	default 64

config FLASH_BASE_ADDRESS
	default 0x08000000

endif
```
