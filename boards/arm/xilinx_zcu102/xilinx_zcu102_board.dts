/dts-v1/;
#include <arm/xilinx/zynqmp.dtsi>

/ {
	model = "Xilinx ZynqMP ZCU102";
	compatible = "xlnx,zynqmp";

	chosen {
		zephyr,console = &uart0;
		zephyr,sram = &sram0;
		zephyr,flash = &flash0;
	};
};

&uart0 {
	status = "okay";
	current-speed = <115200>;
	clock-frequency = <100000000>;
};

&ttc0 {
	status = "okay";
	clock-frequency = <100000000>;
};
